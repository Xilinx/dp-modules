## Documentation/devicetree/bindings/xlnx,v-dp-rx-ss.txt
```
Xilinx DP RX Subsystem

The Xilinx DP RX Subsystem contains several subcores to implement
a DP receiver. /dp/xilinx-dprxss.c implements a
V4L2 video-capture sub-device for the Xilinx Video IP Pipeline device
(xilinx-vipp).

Refer to xlnx,vphy.txt for the phy specifics.

Required Properties:
 - compatible: Should be "xlnx,v-dp-rxss1-2.0".
 - reg: Base address and size of the IP core.
 - interrupts-parent: phandle for interrupt controller.
 - interrupts: Interrupt numbers for mandatory
 - interrupt-names: Identification string that binds irq number to block
		generating the interrupt
		"dprxss_dp_irq": interrupt for rx subcore [always present]

 - clocks: phandle for axi-lite,video clock,stream clock,link clock.
 - clock-names: The identification string, "s_axi_aclk", is always required for
                the axi-lite clock, "rx_vid_clk" is always required for video clock,
		"m_axis_aclk_stream1" is always required for stream clock,"rx_lnk_clk" is 
		always required for link clock 
	
 - phys: phandle for phy lanes registered for dp protocol. DP always
         require 4 lanes
 - phy-names: The identification string, "dp-phy0" and so on
 - ports: Video ports, using the DT bindings defined in ../video-interfaces.txt.
          The Rx only has an output port (0).

==Example==

	 dp_rx_hier_0_v_dp_rxss1_0: v_dp_rxss1@a0040000 {
                         clock-names = "s_axi_aclk", "rx_vid_clk", "m_axis_aclk_stream1", 
			"rx_lnk_clk", "m_aud_axis_aclk";
                         clocks = <&zynqmp_clk 71>, <&zynqmp_clk 72>, <&zynqmp_clk 72>, 
			<&misc _clk_1>, <&zynqmp_clk 71>;
                         compatible = "xlnx,v-dp-rxss1-2.0";
                         interrupt-names = "dprxss_dp_irq";
                         interrupt-parent = <&gic>;
                         interrupts = <0 89 4>;
                         xlnx,xlnx-vid-edid = <&dp_rx_hier_0_vid_edid_0>;
                         reg = <0x0 0xa0040000 0x0 0x40000>;
                         phy-names = "dp-phy0", "dp-phy1", "dp-phy2", "dp-phy3";
                         phys = <&vphy_lane0 0 1 1 0>, <&vphy_lane1 0 1 1 0>, 
				<&vphy_lane2 0 1     1 0>, <&vphy_lane3 0 1 1 0>;
                         
			 ports {
                         	#address-cells = <1>;
                         	#size-cells = <0>;
                         	port@0 {
                                	 reg = <0>;
 	                                /* DP RX SS -> FB-WR */
                                         xlnx,video-format = <0>;
                                         xlnx,video-width = <8>;
 
                	                 dp_rxss_out: endpoint {
                        	                 remote-endpoint = <&remap0_in>;
                                		 };
                        		 };
                		 };
			};
```

## Documentation/devicetree/bindings/xlnx,v-dp-tx-ss.txt
```
Xilinx DP TX Subsystem

The Xilinx DP TX Subsystem contains several subcores to implement
a DP Transmitter. xlnx_drm_dp.c implements a DRM/KMS driver
encoder/connector interface in the output pipeline.

Note: This version of the driver interfaces with the new Xilinx DRM component
	  framework and is not backward compatible with the earlier encoder-slave
	  interface. As such compatibility string has been reved up to indicate the
	  new interface.

Refer to xlnx,vphy.txt for the phy specifics.

Required properties:
 - compatible: Should be "xlnx,v-dp-txss1-2.1".
 - reg: Base address and size of the IP core
 - interrupts-parent: phandle for interrupt controller.
 - interrupts: Interrupt number for tx subcore
 - interrupt-names: Identification string that binds irq number to block
		generating the interrupt
		"dptxss_dp_irq": interrupt for tx subcore [always present]
 - clocks: phandle for axi-lite, on board si570 clock
 - clock-names: The identification string for various clock inputs
				"s_axi_aclk", is always required for the axi-lite clock
				"tx_vid_clk_stream1" is always required for video stream clock

 - phys: phandle for phy lanes registered for hdmi protocol. DP always
         require 4 lanes
 - phy-names: The identification string, "dp-phy0" and so on
 - xlnx,max-link-rate : maximum link rate supported
 - xlnx,max-bpc : The data width per video component (8,10,12,16)
           Note: Only 8 & 10 is supported at this time 
 - xlnx,audio-chan : No of audio channels configured
 - xlnx,max-pclock-frequency: Maximum pixel clock
 - xlnx,max-lanes:Maximum lanes supported
 - xlnx,remap-tx : remaper-tx node 
 - reset-gpio: GPIO reset for remapper-tx IP 

Sub-Node Properties:
	The device tree will need to include a sub-node for the encoder endpoint
	interface. This port will bind the hdmi encoder with the crtc being used

	Required Properties:
	- ports: Connects to the crtc node through the device graph binding.
	The port should contain a 'remote-endpoint' sub-node that points to the
	endpoint in the port of the crtc/dma-engine device node.

==Example==

	dp_tx_hier_0_v_dp_txss1_0: v_dp_txss1@a0100000 {
        
	                clock-names = "s_axi_aclk","tx_vid_clk_stream1";
                        clocks = <&zynqmp_clk 71>,<&si570_1>;
                        compatible = "xlnx,v-dp-txss1-1.0";
                        interrupt-names = "dptxss_dp_irq";
                        interrupt-parent = <&gic>;
                        interrupts = <0 92 4>;
                        reg = <0x0 0xa0100000 0x0 0x40000>;
                        xlnx,max-lanes = <4>;
                        xlnx,max-link-rate = <810000>;
                        xlnx,max-bpc = <16>;
                        xlnx,colormetry = "rgb";
                        xlnx,bpc = <8>;
                        xlnx,audio-chan = <2>;
                        xlnx,max-pclock-frequency = <300000>;
						xlnx,remap-tx = <&dp_tx_hier_0_remap_tx>; 
						reset-gpio = <&dp_tx_hier_0_axi_gpio_remap_tx 0 0 1>;
                        phy-names = "dp-phy0", "dp-phy1", "dp-phy2", "dp-phy3";
                        phys = <&vphy_lane0 0 1 1 1>, <&vphy_lane1 0 1 1 1>,
						<&vphy_lane2 0 1     1 1>, <&vphy_lane3 0 1 1 1>;
                        encoder_dp_port: port@0 {
                                reg = <0>;
                                dp_encoder: endpoint {
                                        remote-endpoint = <&pl_disp_crtc>;
                                };
                        };
                        	i2c-bus {
                        };

                };


                 v_pl_disp: drm-pl-disp-drv {
                         compatible = "xlnx,pl-disp";
                         dmas = <&dp_tx_hier_0_v_frmbuf_rd_0 0>;
                         dma-names = "dma0";
                         xlnx,vformat = "YUYV";
                         pl_disp_port: port@0 {
                                 reg = <0>;
                                 pl_disp_crtc: endpoint {
                                         remote-endpoint = <&dp_encoder>;
                                 };
                         };
                 };
```

## Documentation/devicetree/bindings/xlnx,vphy.txt
```
Xilinx VPHY (Staging)

The Xilinx Video PHY is a high-level video-specific wrapper around
different versions of the GT PHY. Its driver is phy/phy-xilinx-vphy.c

It offers the PHY driver interface as well as higher-level video
specific support functions.

Its current users are Xilinx DP RX/TX SS.
(See xlnx,v-dp-rx-ss.txt and xlnx,v-dp-tx-ss.txt)


Required Properties:
 - compatible: Should be "xlnx,vid-phy-controller-2.2".
 - reg: Base address and size of the IP core.
 - interrupts: Interrupt number.
 - interrupts-parent: phandle for interrupt controller.
 
 - clocks: phandle for axi-lite clock and dru clock
 - clock-names: The identification string, "axi-lite", is always required
          and "dru-clk" is required for NI DRU clock for phy
		  
 - xlnx,input-pixels-per-clock: IP configuration for samples/clk (1, 2, 4)
         Note: Only 2 is supported at this time

 - xlnx,nidru: flag to indicate if DRU is present
 - xlnx,nidru-refclk-sel: DRU clock selector
 - xlnx,rx-no-of-channels: Required Rx channels for registered protocol
 - xlnx,rx-pll-selection: Rx pll selector
 - xlnx,rx-protocol: 1=HDMI, 0=DP
 - xlnx,rx-refclk-sel: Reference Rx clock selector
 - xlnx,tx-no-of-channels: Required Rx channels for registered protocol
 - xlnx,tx-pll-selection = Tx pll selector
 - xlnx,tx-protocol: 1=HDMI, 0=DP
 - xlnx,tx-refclk-sel: Reference Rx clock selector
 - xlnx,transceiver-type: GT type. Must be set per GT device used
 - xlnx,tx-buffer-bypass: Flag to indicate buffer bypass logic availability
 - xlnx,transceiver-width: Defines 4 Byte or 2 Byte mode
                      (Note: Only 2 byte is supported at this time)

 - lane<n>: (port (child) nodes)
	lane0:
		- #phy-cells	: Should be 4
			Cell after port phandle is device type from:
			- <controller_type controller_instance is_shared direction_tx>

			controller_type = 0 for HDMI
            controller_instance = [0, ...] indexes the instance of the protocol
                                  controller	
            is_shared = 1 if the RX and TX can be shared across the same 
			            protocol/controller
            direction_tx = 0 for RX and 1 for TX

(These properties are intended for future steering of multiple protocols 
sharing VPHYs, and are therefore subject to change.)

==Example==

		vid_phy_controller_0: vid_phy_controller@a0020000 {
		 	clock-names = "axi-lite", "drpclk";
                         clocks = <&zynqmp_clk 71>, <&zynqmp_clk 73>;
			compatible = "xlnx,vid-phy-controller-2.2", "xlnx,vid-phy-controller-2.1";
			interrupt-names = "irq";
			interrupt-parent = <&gic>;
			interrupts = <0 90 4>;
			reg = <0x0 0xa0020000 0x0 0x10000>;
			xlnx,hdmi-fast-switch = <1>;
			xlnx,input-pixels-per-clock = <4>;
			xlnx,nidru = <0>;
			xlnx,nidru-refclk-sel = <0>;
			xlnx,rx-no-of-channels = <4>;
			xlnx,rx-pll-selection = <0>;
			xlnx,rx-protocol = <0>;
			xlnx,rx-refclk-sel = <1>;
			xlnx,transceiver-type = <5>;
			xlnx,transceiver-width = <2>;
			xlnx,tx-buffer-bypass = <0>;
			xlnx,tx-no-of-channels = <4>;
			xlnx,tx-pll-selection = <2>;
			xlnx,tx-protocol = <0>;
			xlnx,tx-refclk-sel = <0>;
			vphy_lane0: vphy_lane@0 {
				#phy-cells = <4>;
			};
			vphy_lane1: vphy_lane@1 {
				#phy-cells = <4>;
			};
			vphy_lane2: vphy_lane@2 {
				#phy-cells = <4>;
			};
			vphy_lane3: vphy_lane@3 {
				#phy-cells = <4>;
			};
		};
```
